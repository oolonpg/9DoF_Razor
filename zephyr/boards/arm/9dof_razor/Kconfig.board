## zephyr/boards/arm/9dof_razor/Kconfig.board
```kconfig
# Copyright (c) 2020 Google LLC.
# SPDX-License-Identifier: Apache-2.0

config BOARD_9DOF_RAZOR
	bool "Sparkfun 9DoF Razor"
	depends on SOC_PART_NUMBER_SAMD21G18A
```

## zephyr/boards/arm/9dof_razor/Kconfig.defconfig
```kconfig
# Copyright (c) 2020 Google LLC.
# SPDX-License-Identifier: Apache-2.0

config BOARD
	default "9DOF_RAZOR"
```

## zephyr/drivers/sensor/ak8963/Kconfig
```kconfig
# AK8975 magnetometer configuration options

# Copyright (c) 2016 Intel Corporation
# SPDX-License-Identifier: Apache-2.0

config AK8963
	bool "AK8963 Magnetometer"
	depends on I2C
	help
	  Enable driver for AK8963 magnetometer.
```

## zephyr/drivers/sensor/mpu9250/Kconfig
```kconfig
# MPU9250 Six-Axis Motion Tracking device configuration options

# Copyright (c) 2016 Intel Corporation
# SPDX-License-Identifier: Apache-2.0

menuconfig MPU9250
	bool "MPU9250 Six-Axis Motion Tracking Device"
	depends on I2C
	help
	  Enable driver for MPU9250 I2C-based six-axis motion tracking device.

if MPU9250

choice
	prompt "Trigger mode"
	default MPU9250_TRIGGER_GLOBAL_THREAD
	help
	  Specify the type of triggering to be used by the driver.

config MPU9250_TRIGGER_NONE
	bool "No trigger"

config MPU9250_TRIGGER_GLOBAL_THREAD
	bool "Use global thread"
	depends on GPIO
	select MPU9250_TRIGGER

config MPU9250_TRIGGER_OWN_THREAD
	bool "Use own thread"
	depends on GPIO
	select MPU9250_TRIGGER

endchoice

config MPU9250_TRIGGER
	bool

config MPU9250_THREAD_PRIORITY
	int "Thread priority"
	depends on MPU9250_TRIGGER_OWN_THREAD
	default 10
	help
	  Priority of thread used by the driver to handle interrupts.

config MPU9250_THREAD_STACK_SIZE
	int "Thread stack size"
	depends on MPU9250_TRIGGER_OWN_THREAD
	default 1024
	help
	  Stack size of thread used by the driver to handle interrupts.

config MPU9250_ACCEL_FS
	int "Accelerometer full-scale range"
	default 2
	help
	  Magnetometer full-scale range.
	  An X value for the config represents a range of +/- X g. Valid
	  values are 2, 4, 8 and 16.

config MPU9250_GYRO_FS
	int "Gyroscope full-scale range"
	default 250
	help
	  Gyroscope full-scale range.
	  An X value for the config represents a range of +/- X degrees/second.
	  Valid values are 250, 500, 1000, 2000.

endif # MPU9250
```

## zephyr/dts/bindings/sensor/asahi-kasei,ak8963.yaml
```yaml
# Copyright (c) 2020, Linaro Limited
# SPDX-License-Identifier: Apache-2.0

description: |
    Asahi Kasei AK8963 Magnetometer. See datasheet at
    https://www.akm.com/akm/en/file/datasheet/AK8963.pdf

compatible: "asahi-kasei,ak8963"

include: i2c-device.yaml
```
